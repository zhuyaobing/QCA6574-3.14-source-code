## meta-qti-connectivity/conf/layer.conf
```bitbake
BBPATH .= ":${LAYERDIR}"

# We have recipes-* directories, add to BBFILES
BBFILES += "${LAYERDIR}/recipes-*/*/*.bb \
            ${LAYERDIR}/recipes-*/*/*.bbappend"

BBFILE_COLLECTIONS += "qti-connectivity"
BBFILE_PATTERN_qti-connectivity := "^${LAYERDIR}"
BBFILE_PRIORITY_qti-connectivity = "12"
```

## meta-qti-connectivity/conf/machine/8x96connx.conf
```bitbake
#@TYPE: Machine
#@NAME: msm8996

#@DESCRIPTION: Machine configuration for 8x96connx kernel4.4

require ${COREBASE}/meta-qti-bsp/conf/machine/include/auto-common.inc

BASEMACHINE = "8x96auto"
# support early_init feature
# DISTRO_FEATURES_append += " early_init"

# support early-ethernet feature
# DISTRO_FEATURES_append += " early-ethernet"

IMAGE_FEATURES += "read-only-rootfs"

MACHINE_FEATURES_BACKFILL_remove += "qemu-usermode"

DISTRO_FEATURES_remove += "3g jrda pcmcia nfc libc-cxx-tests"
DISTRO_FEATURES_remove += "${@'pulseaudio' if '${WITH_INTERNAL_LAYER}' == 'no' else ''}"

MACHINE_EXTRA_RRECOMMENDS = " kernel-modules kernel-devicetree"

PREFERRED_PROVIDER_virtual/kernel = "linux-msm-4.4"

CONSOLE_DEVICE = "ttyMSM0"

# for dm-verity
ROOT_DEVICE = "/dev/mmcblk0p18"

SYNERGY_DIR_PRESENT = "${@os.path.exists('${WORKSPACE}/prebuilt_HY11/8x96auto/synergy') or os.path.exists('${WORKSPACE}/prebuilt_HY22/8x96auto/synergy') or os.path.exists('${WORKSPACE}/synergy/synergy-bootstrap')}"

# if is "/dev/dm-0", dm-verity enabled on ${ROOT_DEVICE}
# if is ${ROOT_DEVICE}, no dm-verity
#KERNEL_ROOTDEVICE ?= "/dev/dm-0"
KERNEL_ROOTDEVICE ?= "${ROOT_DEVICE}"

KERNEL_IMAGETYPE ?= "Image"
KERNEL_DEVICETREE ?= "qcom/apq8096pro-auto-cdp.dtb qcom/apq8096pro-v1.1-auto-adp.dtb qcom/apq8096pro-v1.1-auto-adp-lite.dtb qcom/apq8096pro-v1.1-auto-cdp.dtb qcom/apq8096-v2-auto-dragonboard.dtb qcom/apq8096-v3-auto-adp.dtb qcom/apq8096-v3-auto-cdp.dtb qcom/apq8096-v3-auto-dragonboard.dtb qcom/msm8996pro-auto-adp.dtb qcom/msm8996pro-auto-adp-lite.dtb qcom/msm8996pro-auto-cdp.dtb qcom/msm8996pro-v1.1-auto-cdp.dtb qcom/msm8996-v3-auto-adp.dtb qcom/msm8996-v3-auto-cdp.dtb qcom/msm8996-v3-pm8004-agave-adp.dtb qcom/msm8996-v3-pm8004-agave-adp-lite.dtb qcom/msm8996-v3-pm8004-mmxf-adp.dtb"
KERNEL_DTS_NAME = "msm8996"
KERNEL_BASE = "0x80000000"
KERNEL_TAGS_OFFSET = "0x81900000"
KERNEL_CMD_PARAMS = "console=${CONSOLE_DEVICE},115200,n8 androidboot.console=${CONSOLE_DEVICE} androidboot.hardware=qcom user_debug=31 msm_rtb.filter=0x237 ehci-hcd.park=3 cma=16M@0-0xffffffff rootwait rootfstype=ext4 root=${KERNEL_ROOTDEVICE} fsck.repair=yes firmware_class.path=/firmware/image/ oops=panic"
KERNEL_PERF_CMD_PARAMS = "console=${CONSOLE_DEVICE},115200,n8 androidboot.console=${CONSOLE_DEVICE} androidboot.hardware=qcom user_debug=31 msm_rtb.filter=0x237 ehci-hcd.park=3 cma=16M@0-0xffffffff rootwait rootfstype=ext4 root=${KERNEL_ROOTDEVICE} fsck.repair=yes firmware_class.path=/firmware/image/ oops=panic"
RECOVERY_CMD_PARAMS = "console=${CONSOLE_DEVICE},115200,n8 androidboot.console=${CONSOLE_DEVICE} androidboot.hardware=qcom user_debug=31 msm_rtb.filter=0x237 ehci-hcd.park=3 lpm_levels.sleep_disabled=1 cma=16M@0-0xffffffff rootfstype=ramfs root=/dev/ram0 rdinit=/sbin/init"

SERIAL_CONSOLE = "115200 ${CONSOLE_DEVICE}"

PACKAGECONFIG_append_pn-connman = " vpnc ipsecvici"
PACKAGECONFIG_append_pn-strongswan = " swanctl systemd-charon"

require ${WORKSPACE}/sources/meta-qti-connectivity-prop/conf/machine/8x96connx.conf

BBMASK_append = "|meta-qti-bsp/recipes-display/display-hal/display-hal-linux_git.bb"
BBMASK_append = "|meta-qti-bsp/recipes-display/display-hal/display-hal_git.bb"
BBMASK_append = "|meta-qti-bsp/recipes-display/sdm/sdm.bb"
BBMASK_append = "|meta-qti-bsp/recipes-graphics/wayland/weston_%.bbappend"
BBMASK_append = "|meta-qti-bsp/recipes-products/images/automotive-image.bb"
BBMASK_append = "|meta-qti-bsp/recipes-products/images/machine-recovery-image.bb"
BBMASK_append = "|meta-qti-bsp/recipes-multimedia/"
BBMASK_append = "|meta-qti-bsp/recipes-connectivity/wlan/qcacld_2.0.bb"
BBMASK_append = "|meta-qti-bsp/recipes-connectivity/wlan/qcacld-dsrc_2.0.bb"
BBMASK_append = "|meta-qti-bsp/recipes-connectivity/wlan/qcacld-hl_2.0.bb"
BBMASK_append = "|meta-qti-bsp/recipes-connectivity/wlan/qcacld-hl_git.bb"
BBMASK_append = "|meta-qti-bsp/recipes-connectivity/wlan/qcacld-ll_git.bb"
BBMASK_append = "|meta-qti-bsp/recipes-connectivity/wpa-supplicant/wpa-supplicant_2.5.bbappend"
BBMASK_append = "|meta-qti-bsp/recipes-connectivity/hostap-daemon/hostapd_2.5.bbappend"
BBMASK_append = "|meta-qti-bsp/recipes-connectivity/sigma-dut/sigma-dut_git.bb"
BBMASK_append = "|meta-qti-connectivity/recipes-products/images/standalone-auto-image.bb"
BBMASK_append = "|meta-qti-connectivity/recipes-products/images/standalone-imx8auto-image.bb"
BBMASK_append = "|meta-qti-connectivity/recipes-connectivity/wlan-driver/qcacld-hl_2.0.bb"
BBMASK_append = "|meta-qti-connectivity/recipes-connectivity/wlan-driver/qcacld-hl-tfl_2.0.bb"
BBMASK_append = "|meta-qti-connectivity/recipes-connectivity/wlan-driver/qcacld-ll_2.0.bb"
BBMASK_append = "|meta-qti-connectivity/recipes-connectivity/wlan-driver/qcacld-hl-rome_2.0.bb"
BBMASK_append = "|meta-qti-connectivity/recipes-core/systemd/systemd_%.bbappend"
BBMASK_append = "|meta-qti-connectivity/recipes-kernel/linux-kernel/linux-imx_%.bbappend"
BBMASK_append = "|meta-qti-connectivity/recipes-kernel/linux-kernel/linux-imx_3.10.17.bbappend"
```
